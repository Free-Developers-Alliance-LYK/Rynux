## init/Kconfig
```kconfig
menu "General setup"

config RUSTC_VERSION
	int
	default $(rustc-version)
	help
	  It does not depend on `RUST` since that one may need to use the version
	  in a `depends on`.

config RUST_IS_AVAILABLE
	def_bool $(success,$(srctree)/scripts/rust_is_available.sh)
	help
	  This shows whether a suitable Rust toolchain is available (found).

	  Please see Documentation/rust/quick-start.rst for instructions on how
	  to satisfy the build requirements of Rust support.

	  In particular, the Makefile target 'rustavailable' is useful to check
	  why the Rust toolchain is not being detected.

config RUSTC_LLVM_VERSION
	int
	default $(rustc-llvm-version)

config CLANG_VERSION
	int
        default $(cc-version)

config AS_VERSION
	int
	# Use clang version if this is the integrated assembler
	default CLANG_VERSION

choice
	prompt "Compiler optimization level"
        default CC_OPTIMIZE_FOR_PERFORMANCE
config CC_OPTIMIZE_FOR_PERFORMANCE
        bool "Optimize for performance (-O2)"
        help
	  This is the default optimization level for the kernel, building
          with the "-O2" compiler flag for best performance and most
          helpful compile-time warnings.
config CC_OPTIMIZE_FOR_SIZE
        bool "Optimize for size (-Os)"
        help
          Choosing this option will pass "-Os" to your compiler resulting
          in a smaller kernel.
endchoice

config WERROR
	bool "Compile the kernel with warnings as errors"
	default y
	help
	  A kernel build should not cause any compiler warnings, and this
	  enables the '-Dwarnings' (for Rust) flags to enforce that rule
	  by default. Certain warnings from other tools such as the linker
	  may be upgraded to errors with this option as well.

	  However, if you have a new (or very old) compiler or linker with odd
	  and unusual warnings, or you have some architecture with problems,
	  you may need to disable this config option in order to
	  successfully build the kernel.

	  If in doubt, say Y.


menuconfig EXPERT
	bool "Configure standard kernel features (expert users)"
	# Unhide debug options, to make the on-by-default options visible
	select DEBUG_KERNEL
	help
	  This option allows certain base kernel options and settings
	  to be disabled or tweaked. This is for specialized
	  environments which can tolerate a "non-standard" kernel.
	  Only use this if you really know what you are doing.

choice
	prompt "Maximum Kernel Image size"
	default KERNEL_IMAGE_SIZE_16MB

config KERNEL_IMAGE_SIZE_4MB
	bool "4MB size"
	help
	  This option allows you to set the maximum size of the kernel image
	  to 4MB.

config KERNEL_IMAGE_SIZE_8MB
	bool "8MB size"
	help
	  This option allows you to set the maximum size of the kernel image
	  to 8MB.

config KERNEL_IMAGE_SIZE_16MB
	bool "16MB size"
	help
	  This option allows you to set the maximum size of the kernel image
	  to 16MB.

config KERNEL_IMAGE_SIZE_32MB
	bool "32MB size"
	help
	  This option allows you to set the maximum size of the kernel image
	  to 32MB.
endchoice

config TOOLS_SUPPORT_RELR
	def_bool $(success,env "CC=$(CC)" "LD=$(LD)" "NM=$(NM)" "OBJCOPY=$(OBJCOPY)" $(srctree)/scripts/tools-support-relr.sh)


config KALLSYMS
	bool "Load all symbols for debugging/ksymoops" if EXPERT
	default y
	help
	  Say Y here to let the kernel print out symbolic crash information and
	  symbolic stack backtraces. This increases the size of the kernel
	  somewhat, as all symbols have to be loaded into the kernel image.

config KALLSYMS_ALL
	bool "Include all symbols in kallsyms"
	depends on KALLSYMS
	help
	  Say Y here to force all symbols to be included in the
	  kernel's kallsyms table. Normally kallsyms only contains
	  the symbols of functions for which a stack trace should be
	  possible, but saying Y here will add all kernel symbols.
endmenu
```

## lib/Kconfig.debug
```kconfig
# SPDX-License-Identifier: GPL-2.0-only
menu "Kernel hacking"

config ARCH_WANT_FRAME_POINTERS
	bool

config FRAME_POINTER
	bool "Compile the kernel with frame pointers"
	default y if ARCH_WANT_FRAME_POINTERS
	help
	  If you say Y here the resulting kernel image will be slightly
	  larger and slower, but it gives very useful debugging information
	  in case of kernel bugs. (precise oopses/stacktraces/warnings)

config RUST_DEBUG_ASSERTIONS
	bool "Debug assertions"
	help
	  Enables rustc's `-Cdebug-assertions` codegen option.

	  This flag lets you turn `cfg(debug_assertions)` conditional
	  compilation on or off. This can be used to enable extra debugging
	  code in development but not in production. For example, it controls
	  the behavior of the standard library's `debug_assert!` macro.

	  Note that this will apply to all Rust code, including `core`.

	  If unsure, say N.

config RUST_OVERFLOW_CHECKS
	bool "Overflow checks"
	default y
	help
	  Enables rustc's `-Coverflow-checks` codegen option.

	  This flag allows you to control the behavior of runtime integer
	  overflow. When overflow-checks are enabled, a Rust panic will occur
	  on overflow.

	  Note that this will apply to all Rust code, including `core`.

	  If unsure, say Y.

config RUST_BUILD_ASSERT_ALLOW
	bool "Allow unoptimized build-time assertions"
	help
	  Controls how `build_error!` and `build_assert!` are handled during the build.

	  If calls to them exist in the binary, it may indicate a violated invariant
	  or that the optimizer failed to verify the invariant during compilation.

	  This should not happen, thus by default the build is aborted. However,
	  as an escape hatch, you can choose Y here to ignore them during build
	  and let the check be carried at runtime (with `panic!` being called if
	  the check fails).

	  If unsure, say N.

config VMLINUX_MAP
	bool "Generate vmlinux.map file when linking"
	depends on EXPERT
	help
	  Selecting this option will pass "-Map=vmlinux.map" to ld
	  when linking vmlinux. That file can be useful for verifying
	  and debugging magic section games, and for seeing which
	  pieces of code get eliminated with
	  CONFIG_LD_DEAD_CODE_DATA_ELIMINATION.



endmenu # Kernel hacking
```
