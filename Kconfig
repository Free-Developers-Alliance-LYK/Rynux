## Kconfig
```kconfig
# For a description of the syntax of this configuration file,
# see Linux/Documentation/kbuild/kconfig-language.rst.
#
#
mainmenu "Rynux/$(ARCH) Kernel Configuration"

source "scripts/Kconfig.include"

source "arch/Kconfig"

source "init/Kconfig"

source "klib/Kconfig.debug"
```

## arch/Kconfig
```kconfig
# General architecture dependent options
#
# Note: arch/$(SRCARCH)/Kconfig needs to be included first so that it can
# override the default values in this file.
#

menu "General architecture-dependent options"

config FUNCTION_ALIGNMENT_4B
        bool
config FUNCTION_ALIGNMENT_8B
        bool
config FUNCTION_ALIGNMENT_16B
        bool
config FUNCTION_ALIGNMENT_32B
        bool
config FUNCTION_ALIGNMENT_64B
	bool

config HAVE_PAGE_SIZE_4KB
	bool

config HAVE_PAGE_SIZE_8KB
	bool

config HAVE_PAGE_SIZE_16KB
	bool

config HAVE_PAGE_SIZE_32KB
	bool

config HAVE_PAGE_SIZE_64KB
	bool

config HAVE_PAGE_SIZE_256KB
	bool

config 64BIT
	bool

choice
	prompt "MMU page size"

config PAGE_SIZE_4KB
	bool "4KiB pages"
	depends on HAVE_PAGE_SIZE_4KB
	help
	  This option select the standard 4KiB Linux page size and the only
	  available option on many architectures. Using 4KiB page size will
	  minimize memory consumption and is therefore recommended for low
	  memory systems.
	  Some software that is written for x86 systems makes incorrect
	  assumptions about the page size and only runs on 4KiB pages.

config PAGE_SIZE_8KB
	bool "8KiB pages"
	depends on HAVE_PAGE_SIZE_8KB
	help
	  This option is the only supported page size on a few older
	  processors, and can be slightly faster than 4KiB pages.

config PAGE_SIZE_16KB
	bool "16KiB pages"
	depends on HAVE_PAGE_SIZE_16KB
	help
	  This option is usually a good compromise between memory
	  consumption and performance for typical desktop and server
	  workloads, often saving a level of page table lookups compared
	  to 4KB pages as well as reducing TLB pressure and overhead of
	  per-page operations in the kernel at the expense of a larger
	  page cache.

config PAGE_SIZE_32KB
	bool "32KiB pages"
	depends on HAVE_PAGE_SIZE_32KB
	help
	  Using 32KiB page size will result in slightly higher performance
	  kernel at the price of higher memory consumption compared to
	  16KiB pages.	This option is available only on cnMIPS cores.
	  Note that you will need a suitable Linux distribution to
	  support this.

config PAGE_SIZE_64KB
	bool "64KiB pages"
	depends on HAVE_PAGE_SIZE_64KB
	help
	  Using 64KiB page size will result in slightly higher performance
	  kernel at the price of much higher memory consumption compared to
	  4KiB or 16KiB pages.
	  This is not suitable for general-purpose workloads but the
	  better performance may be worth the cost for certain types of
	  supercomputing or database applications that work mostly with
	  large in-memory data rather than small files.

config PAGE_SIZE_256KB
	bool "256KiB pages"
	depends on HAVE_PAGE_SIZE_256KB
	help
	  256KiB pages have little practical value due to their extreme
	  memory usage.  The kernel will only be able to run applications
	  that have been compiled with '-zmax-page-size' set to 256KiB
	  (the default is 64KiB or 4KiB on most architectures).

endchoice

# Select if the architecture supports the RELR relocation format
config ARCH_HAS_RELR
	bool

config RELR
	bool "Use RELR relocation packing"
	depends on ARCH_HAS_RELR && TOOLS_SUPPORT_RELR
	default y
	help
	  Store the kernel's dynamic relocations in the RELR relocation packing
	  format. Requires a compatible linker (LLD supports this feature), as
	  well as compatible NM and OBJCOPY utilities (llvm-nm and llvm-objcopy
	  are compatible).


config HAVE_ARCH_VMAP_STACK
	def_bool n
	help
	  An arch should select this symbol if it can support kernel stacks
	  in vmalloc space.  This means:

	  - vmalloc space must be large enough to hold many kernel stacks.
	    This may rule out many 32-bit architectures.

	  - Stacks in vmalloc space need to work reliably.  For example, if
	    vmap page tables are created on demand, either this mechanism
	    needs to work while the stack points to a virtual address with
	    unpopulated page tables or arch code (switch_to() and switch_mm(),
	    most likely) needs to ensure that the stack's page table entries
	    are populated before running on a possibly unpopulated stack.

	  - If the stack overflows into a guard page, something reasonable
	    should happen.  The definition of "reasonable" is flexible, but
	    instantly rebooting without logging anything would be unfriendly.

config VMAP_STACK
	default y
	bool "Use a virtually-mapped stack"
	depends on HAVE_ARCH_VMAP_STACK
	help
	  Enable this if you want the use virtually-mapped kernel stacks
	  with guard pages.  This causes kernel stack overflows to be
	  caught immediately rather than causing difficult-to-diagnose
	  corruption.

config HAVE_EFFICIENT_UNALIGNED_ACCESS
	bool
	help
	  Some architectures are unable to perform unaligned accesses
	  without the use of get_unaligned/put_unaligned. Others are
	  unable to perform such accesses efficiently (e.g. trap on
	  unaligned access and require fixing it up in the exception
	  handler.)

	  This symbol should be selected by an architecture if it can
	  perform unaligned accesses efficiently to allow different
	  code paths to be selected for these cases. Some network
	  drivers, for example, could opt to not fix up alignment
	  problems with received packets if doing so would not help
	  much.

	  See Documentation/core-api/unaligned-memory-access.rst for more
	  information on the topic of unaligned memory accesses.



endmenu # General architecture-dependent options

source "arch/$(SRCARCH)/Kconfig"
```

## arch/arm64/Kconfig
```kconfig
config ARM64
	def_bool y
        select ARCH_WANT_FRAME_POINTERS
	select FUNCTION_ALIGNMENT_4B
	select HAVE_ARCH_VMAP_STACK
	select 64BIT
	select HAVE_EFFICIENT_UNALIGNED_ACCESS
	select ARM_AMBA

choice
	prompt "Platform"
	default QEMU
	help
	  Select the platform you are building for.

config QEMU
	bool "QEMU"
	help
	  Platform for Qemu

config RASPI4B
	bool "Raspberry Pi 4B"
	help
	  Platform for Raspberry Pi 4B

endchoice



config BROKEN_GAS_INST
	def_bool !$(as-instr,1:\n.inst 0\n.rept . - 1b\n\nnop\n.endr\n)


menu "Arm64 architecture options"

choice
	prompt "Endianness"
	default CPU_LITTLE_ENDIAN
	help
	  Select the endianness of data accesses performed by the CPU. Userspace
	  applications will need to be compiled and linked for the endianness
	  that is selected here.

config CPU_LITTLE_ENDIAN
	bool "Build little-endian kernel"
	help
	  Say Y if you plan on running a kernel with a little-endian userspace.
	  This is usually the case for distributions targeting arm64.

endchoice


config BROKEN_GAS_INST
	def_bool !$(as-instr,1:\n.inst 0\n.rept . - 1b\n\nnop\n.endr\n)

menu "ARMv8.2 architectural features"
config AS_HAS_ARMV8_2
	def_bool $(cc-option,-Wa$(comma)-march=armv8.2-a)

endmenu # ARMv8.2 architectural features

menu "ARMv8.3 architectural features"

config AS_HAS_ARMV8_3
	def_bool $(cc-option,-Wa$(comma)-march=armv8.3-a)
endmenu # ARMv8.3 architectural features

menu "ARMv8.4 architectural features"

config AS_HAS_ARMV8_4
	def_bool $(cc-option,-Wa$(comma)-march=armv8.4-a)

endmenu # ARMv8.4 architectural features


menu "ARMv8.5 architectural features"

config AS_HAS_ARMV8_5
	def_bool $(cc-option,-Wa$(comma)-march=armv8.5-a)

endmenu # ARMv8.5 architectural features

menu "ARM errata workarounds via the alternatives framework"

config ARM64_ERRATUM_843419
	bool "Cortex-A53: 843419: A load or store might access an incorrect address"
	default y
	help
	  This option links the kernel with '--fix-cortex-a53-843419' and
	  enables PLT support to replace certain ADRP instructions, which can
	  cause subsequent memory accesses to use an incorrect address on
	  Cortex-A53 parts up to r0p4.

	  If unsure, say Y.

config ARM64_LD_HAS_FIX_ERRATUM_843419
	def_bool $(ld-option,--fix-cortex-a53-843419)


config FUJITSU_ERRATUM_010001
	bool "Fujitsu-A64FX erratum E#010001: Undefined fault may occur wrongly"
	default y
	help
	  This option adds a workaround for Fujitsu-A64FX erratum E#010001.
	  On some variants of the Fujitsu-A64FX cores ver(1.0, 1.1), memory
	  accesses may cause undefined fault (Data abort, DFSC=0b111111).
	  This fault occurs under a specific hardware condition when a
	  load/store instruction performs an address translation using:
	  case-1  TTBR0_EL1 with TCR_EL1.NFD0 == 1.
	  case-2  TTBR0_EL2 with TCR_EL2.NFD0 == 1.
	  case-3  TTBR1_EL1 with TCR_EL1.NFD1 == 1.
	  case-4  TTBR1_EL2 with TCR_EL2.NFD1 == 1.

	  The workaround is to ensure these bits are clear in TCR_ELx.
	  The workaround only affects the Fujitsu-A64FX.

	  If unsure, say Y.

 config ARM64_ERRATUM_845719
          bool "Cortex-A53: 845719: a load might read incorrect data"
          depends on COMPAT
          default y
          help
            This option adds an alternative code sequence to work around ARM
            erratum 845719 on Cortex-A53 parts up to r0p4.

            When running a compat (AArch32) userspace on an affected Cortex-A53
            part, a load at EL0 from a virtual address that matches the bottom 32
            bits of the virtual address used by a recent load at (AArch64) EL1
            might return incorrect data.

	    The workaround is to write the contextidr_el1 register on exception
            return to a 32-bit task.
            Please note that this does not necessarily enable the workaround,
            as it depends on the alternative framework, which will only patch
            the kernel if an affected CPU is detected.
            If unsure, say Y.

endmenu # ARM errata workarounds via the alternatives framework

menuconfig COMPAT
          bool "Kernel support for 32-bit EL0"
          depends on ARM64_4K_PAGES || EXPERT
          #select HAVE_UID16
	  #select OLD_SIGSUSPEND3
          #select COMPAT_OLD_SIGACTION
          help
            This option enables support for a 32-bit EL0 running under a 64-bit
            kernel at EL1. AArch32-specific components such as system calls,
            the user helper functions, VFP support and the ptrace interface are
            handled appropriately by the kernel.

	    If you use a page size other than 4KB (i.e, 16KB or 64KB), please
	    be aware that you will only be able to execute AArch32 binaries that
	    were compiled with page size aligned segments.
            If you want to execute 32-bit userspace applications, say Y.

menu "ARM64 Mem Management options"

choice
	prompt "Page size"
	default ARM64_4K_PAGES
	help
	  Page size (translation granule) configuration.

config ARM64_4K_PAGES
	bool "4KB"
	select HAVE_PAGE_SIZE_4KB
	help
	  This feature enables 4KB pages support.

config ARM64_16K_PAGES
	bool "16KB"
	select HAVE_PAGE_SIZE_16KB
	help
	  The system will use 16KB pages support. AArch32 emulation
	  requires applications compiled with 16K (or a multiple of 16K)
	  aligned segments.

config ARM64_64K_PAGES
	bool "64KB"
	select HAVE_PAGE_SIZE_64KB
	help
	  This feature enables 64KB pages support (4KB by default)
	  allowing only two levels of page tables and faster TLB
	  look-up. AArch32 emulation requires applications compiled
	  with 64K aligned segments.
endchoice


choice
	prompt "Virtual address space size"
	default ARM64_VA_BITS_48
	help
	  Allows choosing one of multiple possible virtual address
	  space sizes. The level of translation table is determined by
	  a combination of page size and virtual address space size.

config ARM64_VA_BITS_36
	bool "36-bit" if EXPERT
	depends on PAGE_SIZE_16KB

config ARM64_VA_BITS_39
	bool "39-bit"
	depends on PAGE_SIZE_4KB

config ARM64_VA_BITS_42
	bool "42-bit"
	depends on PAGE_SIZE_64KB

config ARM64_VA_BITS_47
	bool "47-bit"
	depends on PAGE_SIZE_16KB

config ARM64_VA_BITS_48
	bool "48-bit"

endchoice

config ARM64_VA_BITS
	int
	default 36 if ARM64_VA_BITS_36
	default 39 if ARM64_VA_BITS_39
	default 42 if ARM64_VA_BITS_42
	default 47 if ARM64_VA_BITS_47
	default 48 if ARM64_VA_BITS_48

choice
	prompt "Physical address space size"
	default ARM64_PA_BITS_48
	help
	  Choose the maximum physical address range that the kernel will
	  support.

config ARM64_PA_BITS_48
	bool "48-bit"
	help 
	  This feature enables 48-bit physical address space support.

config ARM64_PA_BITS_52
	bool "52-bit"
	depends on ARM64_64K_PAGES
	help
	  Enable support for a 52-bit physical address space, introduced as
	  part of the ARMv8.2-LPA extension.

	  With this enabled, the kernel will also continue to work on CPUs that
	  do not support ARMv8.2-LPA, but with some added memory overhead (and
	  minor performance overhead).

endchoice

config ARM64_PA_BITS
	int
	default 48 if ARM64_PA_BITS_48
	default 52 if ARM64_PA_BITS_52

endmenu # ARM64 Mem Management options

config RELOCATABLE
	bool "Build a relocatable kernel image" if EXPERT
	select ARCH_HAS_RELR
	default y
	help
	  This builds the kernel as a Position Independent Executable (PIE),
	  which retains all relocation metadata required to relocate the
	  kernel binary at runtime to a different virtual address than the
	  address it was linked at.
	  Since AArch64 uses the RELA relocation format, this requires a

endmenu # ARM64 architecture options
```

## drivers/Kconfig
```kconfig
# SPDX-License-Identifier: GPL-2.0

menu "Device Drivers"

source "drivers/amba/Kconfig"
source "drivers/tty/Kconfig"

endmenu
```

## drivers/tty/Kconfig
```kconfig
# SPDX-License-Identifier: GPL-2.0

config TTY
	bool "Enable TTY " if EXPERT
	default y
	help
	  Allows you to remove TTY support which can save space, and 
          blocks features that require TTY from inclusion in the kernel. 
	  TTY is required for any text terminals or serial port 
	  communication. Most users should leave this enabled.
 

if TTY

source "drivers/tty/serial/Kconfig"

endif # TTY
```

## drivers/tty/serial/Kconfig
```kconfig
menu "Serial drivers"

config SERIAL_AMBA_PL011
	bool "ARM AMBA PL011 serial port support"
	depends on ARM_AMBA
	help
	 This selects the ARM(R) AMBA(R) PrimeCell PL010 UART.  If you have
	 an Integrator/AP or Integrator/PP2 platform, or if you have a 
	 Cirrus Logic EP93xx CPU, say Y here.

	 If unsure, say N.

endmenu
```
